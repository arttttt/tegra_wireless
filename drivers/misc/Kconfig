## drivers/misc/Kconfig
```kconfig
append_menu "Misc devices"

config BLUEDROID_PM
	tristate "Bluedroid_pm driver support"
	help
	  Bluetooth Bluedroid power management Driver.
	  This driver provides power control and dynamic active power saving
	  mechanism for bluetooth radio devices.

	  Say Y here to compile support for bluedroid_pm support into the kernel
	  or say M to compile it as module (bluedroid_pm).

endmenu
```
